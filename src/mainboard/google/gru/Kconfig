## src/mainboard/google/gru/Kconfig
```kconfig
##
## This file is part of the coreboot project.
##
## Copyright 2016 Rockchip Inc.
##
## This program is free software; you can redistribute it and/or modify
## it under the terms of the GNU General Public License as published by
## the Free Software Foundation; version 2 of the License.
##
## This program is distributed in the hope that it will be useful,
## but WITHOUT ANY WARRANTY; without even the implied warranty of
## MERCHANTABILITY or FITNESS FOR A PARTICULAR PURPOSE.  See the
## GNU General Public License for more details.
##

config BOARD_GOOGLE_GRU  # Umbrella option to be selected by variant boards.
	def_bool n

if BOARD_GOOGLE_GRU

config BOARD_SPECIFIC_OPTIONS
	def_bool y
	select BOARD_ID_AUTO
	select BOARD_ROMSIZE_KB_8192
	select COMMON_CBFS_SPI_WRAPPER
	select HAVE_HARD_RESET
	select MAINBOARD_DO_NATIVE_VGA_INIT
	select MAINBOARD_HAS_CHROMEOS
	select MAINBOARD_HAS_NATIVE_VGA_INIT
	select SOC_ROCKCHIP_RK3399
	select SPI_FLASH
	select SPI_FLASH_GIGADEVICE
	select SPI_FLASH_WINBOND

config CHROMEOS
	select CHROMEOS_VBNV_FLASH
	select VBOOT2_MOCK_SECDATA
	select VIRTUAL_DEV_SWITCH

config MAINBOARD_DIR
	string
	default google/gru

if EVB_MODE
config MAINBOARD_PART_NUMBER
	string "Name of the board variant"
	default "rk3399evb"

config PMIC_BUS
        int
        default 0
endif

if !EVB_MODE
config MAINBOARD_PART_NUMBER
	string "Name of the board variant"
	default "gru"
endif

config DRAM_SIZE_MB
	int
	default 4096

config MAINBOARD_VENDOR
	string
	default "Google"

config EC_GOOGLE_CHROMEEC_SPI_BUS
	hex
	default 0

config BOOT_MEDIA_SPI_BUS
	int
	default 1

config CONSOLE_SERIAL_UART_ADDRESS
	hex
	depends on DRIVERS_UART
	default 0xFF1A0000

config EVB_MODE
       bool "Build image for EVB"
       default n

endif # BOARD_GOOGLE_GRU
```

## src/mainboard/google/kevin/Kconfig
```kconfig
##
## This file is part of the coreboot project.
##
## Copyright 2016 Rockchip Inc.
##
## This program is free software; you can redistribute it and/or modify
## it under the terms of the GNU General Public License as published by
## the Free Software Foundation; version 2 of the License.
##
## This program is distributed in the hope that it will be useful,
## but WITHOUT ANY WARRANTY; without even the implied warranty of
## MERCHANTABILITY or FITNESS FOR A PARTICULAR PURPOSE.  See the
## GNU General Public License for more details.
##

if BOARD_GOOGLE_KEVIN

config BOARD_SPECIFIC_OPTIONS
	def_bool y
	select BOARD_ID_AUTO
	select SOC_ROCKCHIP_RK3399
	select BOARD_ROMSIZE_KB_8192
	select MAINBOARD_HAS_CHROMEOS
	select COMMON_CBFS_SPI_WRAPPER
	select SPI_FLASH
	select SPI_FLASH_GIGADEVICE
	select SPI_FLASH_WINBOND
	select HAVE_HARD_RESET
	select MAINBOARD_HAS_NATIVE_VGA_INIT
	select MAINBOARD_DO_NATIVE_VGA_INIT

config CHROMEOS
	select CHROMEOS_VBNV_FLASH
	select VIRTUAL_DEV_SWITCH
	select VBOOT2_MOCK_SECDATA

config MAINBOARD_DIR
	string
	default google/kevin

if EVB_MODE
config MAINBOARD_PART_NUMBER
	string
	default "rk3399evb"

config DRAM_SIZE_MB
	int
	default 4096

config PMIC_BUS
        int
        default 0
endif

if !EVB_MODE
config MAINBOARD_PART_NUMBER
	string
	default "kevin"

config DRAM_SIZE_MB
	int
	default 4096
endif

config MAINBOARD_VENDOR
	string
	default "Google"

config EC_GOOGLE_CHROMEEC_SPI_BUS
	hex
	default 0

config BOOT_MEDIA_SPI_BUS
	int
	default 1

config CONSOLE_SERIAL_UART_ADDRESS
	hex
	depends on DRIVERS_UART
	default 0xFF1A0000

config EVB_MODE
       bool "Build image for EVB"
       default n

endif # BOARD_GOOGLE_KEVIN
```

## src/mainboard/google/rk3399evb/Kconfig
```kconfig
##
## This file is part of the coreboot project.
##
## Copyright 2016 Rockchip Inc.
##
## This program is free software; you can redistribute it and/or modify
## it under the terms of the GNU General Public License as published by
## the Free Software Foundation; version 2 of the License.
##
## This program is distributed in the hope that it will be useful,
## but WITHOUT ANY WARRANTY; without even the implied warranty of
## MERCHANTABILITY or FITNESS FOR A PARTICULAR PURPOSE.  See the
## GNU General Public License for more details.
##

if BOARD_GOOGLE_RK3399EVB

config BOARD_SPECIFIC_OPTIONS
	def_bool y
	select BOARD_ID_AUTO
	select SOC_ROCKCHIP_RK3399
	select BOARD_ROMSIZE_KB_8192
	select MAINBOARD_HAS_CHROMEOS
	select COMMON_CBFS_SPI_WRAPPER
	select SPI_FLASH
	select SPI_FLASH_GIGADEVICE
	select SPI_FLASH_WINBOND
	select HAVE_HARD_RESET

config CHROMEOS
	select CHROMEOS_VBNV_FLASH
	select VIRTUAL_DEV_SWITCH
	select VBOOT2_MOCK_SECDATA

config MAINBOARD_DIR
	string
	default google/rk3399evb

config MAINBOARD_PART_NUMBER
	string
	default "rk3399evb"

config MAINBOARD_VENDOR
	string
	default "Google"

config DRAM_SIZE_MB
	int
	default 4096

config EC_GOOGLE_CHROMEEC_SPI_BUS
	hex
	default 0

config BOOT_MEDIA_SPI_BUS
	int
	default 1

config CONSOLE_SERIAL_UART_ADDRESS
	hex
	depends on DRIVERS_UART
	default 0xFF1A0000

config PMIC_BUS
	int
	default 0
endif # BOARD_GOOGLE_RK3399EVB
```

## src/mainboard/google/rk3399evb/Kconfig.bak
```kconfig
##
## This file is part of the coreboot project.
##
## Copyright 2016 Rockchip Inc.
##
## This program is free software; you can redistribute it and/or modify
## it under the terms of the GNU General Public License as published by
## the Free Software Foundation; version 2 of the License.
##
## This program is distributed in the hope that it will be useful,
## but WITHOUT ANY WARRANTY; without even the implied warranty of
## MERCHANTABILITY or FITNESS FOR A PARTICULAR PURPOSE.  See the
## GNU General Public License for more details.
##
## You should have received a copy of the GNU General Public License
## along with this program; if not, write to the Free Software
## Foundation, Inc., 51 Franklin St, Fifth Floor, Boston, MA 02110-1301 USA
##

if BOARD_GOOGLE_GRU

config BOARD_SPECIFIC_OPTIONS
	def_bool y
	select BOARD_ID_AUTO
	select SOC_ROCKCHIP_RK3399
	select BOARD_ROMSIZE_KB_4096
	#select RAM_CODE_SUPPORT 
	select CHROMEOS_VBNV_FLASH
	#select EC_GOOGLE_CHROMEEC
	#select EC_GOOGLE_CHROMEEC_SPI
	#select EC_SOFTWARE_SYNC
	#select MAINBOARD_HAS_NATIVE_VGA_INIT
	#select MAINBOARD_DO_NATIVE_VGA_INIT
	select VIRTUAL_DEV_SWITCH
	select MAINBOARD_HAS_CHROMEOS
	select COMMON_CBFS_SPI_WRAPPER
	select SPI_FLASH
	select SPI_FLASH_GIGADEVICE
	select SPI_FLASH_WINBOND
	select MOCK_TPM
	select VBOOT2_MOCK_SECDATA
config MAINBOARD_DIR
	string
	default google/gru

config MAINBOARD_PART_NUMBER
	string
	default "gru"

config MAINBOARD_VENDOR
	string
	default "Google"

config DRAM_SIZE_MB
	int
	default 2048

config EC_GOOGLE_CHROMEEC_SPI_BUS
	hex
	default 0

config BOOT_MEDIA_SPI_BUS
	int
	default 1

config CONSOLE_SERIAL_UART_ADDRESS
	hex
	depends on DRIVERS_UART
	default 0xFF1A0000

endif # BOARD_GOOGLE_GRU
```

## src/soc/rockchip/rk3399/Kconfig
```kconfig
config SOC_ROCKCHIP_RK3399
	bool
	default n
	select ARM64_A53_ERRATUM_843419
	select ARCH_BOOTBLOCK_ARMV8_64
	select ARCH_RAMSTAGE_ARMV8_64
	select ARCH_ROMSTAGE_ARMV8_64
	select ARCH_VERSTAGE_ARMV8_64
	select BOOTBLOCK_CONSOLE
	select HAVE_UART_SPECIAL
	select HAVE_MONOTONIC_TIMER
	select GENERIC_UDELAY
	select UNCOMPRESSED_RAMSTAGE

if SOC_ROCKCHIP_RK3399

config CHROMEOS
	select VBOOT_STARTS_IN_BOOTBLOCK
	select SEPARATE_VERSTAGE
	select RETURN_FROM_VERSTAGE

config PMIC_BUS
	int
	default -1

endif
```
